## CMakeLists.txt
```
# SPDX-License-Identifier: Apache-2.0

cmake_minimum_required(VERSION 3.20.0)

find_package(Zephyr REQUIRED HINTS $ENV{ZEPHYR_BASE})
project(sleep_test_rak5010)

target_sources(app PRIVATE src/main.c)

target_sources_ifdef(CONFIG_BT_PERIPHERAL app PRIVATE src/rak_ble_peripheral.c)
```

## sample.yaml
```
sample:
  name: Modem Sleep Test
tests:
  sample.modem.sleep_test:
    platform_allow:
      - rak5010
    extra_args: EXTRA_CONF_FILE=overlay_ble.conf;overlay_sleep_rak5010.conf
    tags: rak
    build_only: true
```

## prj.conf
```kconfig
CONFIG_GPIO=y
CONFIG_SENSOR=y
CONFIG_I2C=y
CONFIG_REGULATOR=y
CONFIG_UART_ASYNC_API=y

CONFIG_MAIN_STACK_SIZE=2048
CONFIG_SYSTEM_WORKQUEUE_STACK_SIZE=2048

# Modem driver
CONFIG_POSIX_API=y

CONFIG_MODEM=y
CONFIG_MODEM_CELLULAR=y
CONFIG_MODEM_CELLULAR_APN="internet"

# Networking
CONFIG_NETWORKING=y
CONFIG_NET_NATIVE=y
CONFIG_NET_L2_PPP=y

# Logging
CONFIG_LOG=y
CONFIG_LOG_PRINTK=n
# Open following lines to
# use RTT logging for debug!!!
# CONFIG_USE_SEGGER_RTT=y
# CONFIG_LOG_BACKEND_RTT=y
# CONFIG_LOG_BACKEND_UART=n
```

## overlay_sleep_rak5010.conf
```kconfig
# Necessary options for low power consumption
CONFIG_PM_DEVICE=y
CONFIG_LOG=n
CONFIG_LOG_PRINTK=n
CONFIG_BOOT_BANNER=n
CONFIG_DEBUG=n
CONFIG_DEBUG_THREAD_INFO=n
CONFIG_DEBUG_OPTIMIZATIONS=n
# Open to disable USB stack if you need!!!
# RAK5010 uses USB stack and it does not cause to
# increase on idle current.
# CONFIG_CONSOLE=n
# CONFIG_UART_CONSOLE=n
# CONFIG_RTT_CONSOLE=n
# CONFIG_USB_DEVICE_STACK=n
```

## src/main.c
```c
#include <stdio.h>

#include <zephyr/kernel.h>
#include <zephyr/device.h>
#include <zephyr/devicetree.h>
#include <zephyr/drivers/sensor.h>
#include <zephyr/drivers/gpio.h>
#include <zephyr/pm/device.h>
#include <zephyr/pm/device_runtime.h>
#include <zephyr/drivers/regulator.h>

#include "rak_ble_peripheral.h"

#include <zephyr/logging/log.h>
LOG_MODULE_REGISTER(main, LOG_LEVEL_DBG);

/*
 * A build error on this line means your board is unsupported.
 * See the sample documentation for information on how to fix this.
 */
static const struct gpio_dt_spec led = GPIO_DT_SPEC_GET(DT_ALIAS(green_led), gpios);

static void led_init()
{
	if (!gpio_is_ready_dt(&led)) {
		LOG_ERR("LED is not ready!");
	}

	int ret = gpio_pin_configure_dt(&led, GPIO_OUTPUT_ACTIVE);
	if (ret) {
		LOG_ERR("Failed to configure LED!");
	}

	ret = gpio_pin_set_dt(&led, 1); // ON
	if (ret) {
		LOG_ERR("Failed to control LED!");
	}
	k_msleep(1000);
	ret = gpio_pin_set_dt(&led, 0); // OFF
	if (ret) {
		LOG_ERR("Failed to control LED!");
	}

	ret = gpio_pin_configure_dt(&led, GPIO_DISCONNECTED);
	if (ret) {
		LOG_ERR("Failed to disconnect LED!");
	}
}

// Modem Devices
static const struct device *mdm = DEVICE_DT_GET(DT_ALIAS(modem));
static const struct device *mdm_uart = DEVICE_DT_GET(DT_ALIAS(modem_uart));
static const struct device *gps = DEVICE_DT_GET(DT_NODELABEL(gps_pwr));

// Sensor Devices
static const struct device *sensor_temp = DEVICE_DT_GET(DT_ALIAS(temp_sensor));
static const struct device *sensor_light = DEVICE_DT_GET(DT_ALIAS(light_sensor));
static const struct device *sensor_accel = DEVICE_DT_GET(DT_ALIAS(accel_sensor));
static const struct device *sensor_press = DEVICE_DT_GET(DT_ALIAS(press_sensor));

int main(void)
{
	int ret = -1;

#if defined(CONFIG_BT_PERIPHERAL)
	ret = rak_ble_peripheral_init();
	if (ret) {
		LOG_ERR("Failed to init ble peripheral: %d", ret);
	}
#endif

	// Suspend all sensors and BG95 modem
	ret = pm_device_action_run(sensor_temp, PM_DEVICE_ACTION_SUSPEND);
	if (ret) {
		LOG_ERR("Failed to suspend temp sensor: %d", ret);
	}

	ret = pm_device_action_run(sensor_light, PM_DEVICE_ACTION_SUSPEND);
	if (ret) {
		LOG_ERR("Failed to suspend light sensor: %d", ret);
	}

	ret = pm_device_action_run(sensor_accel, PM_DEVICE_ACTION_SUSPEND);
	if (ret) {
		LOG_ERR("Failed to suspend accel sensor: %d", ret);
	}

	ret = pm_device_action_run(sensor_press, PM_DEVICE_ACTION_SUSPEND);
	if (ret) {
		LOG_ERR("Failed to suspend press sensor: %d", ret);
	}

	// Suspend BG95 modem
	ret = regulator_disable(gps);
	if (ret) {
		LOG_ERR("Failed to suspend gps: %d", ret);
	}

	ret = pm_device_action_run(mdm, PM_DEVICE_ACTION_SUSPEND);
	if (ret) {
		LOG_ERR("Failed to suspend modem: %d", ret);
	}

	ret = pm_device_action_run(mdm_uart, PM_DEVICE_ACTION_SUSPEND);
	if (ret) {
		LOG_ERR("Failed to suspend modem: %d", ret);
	}

	// Set up led
	led_init();

	LOG_INF("Sleep Test! %s", CONFIG_BOARD);
	printk("Sleep Test! %s\n", CONFIG_BOARD);

	while (1) {
		k_sleep(K_FOREVER);
	}

	return 0;
}
```
