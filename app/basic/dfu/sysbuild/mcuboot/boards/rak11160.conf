## app/basic/dfu/sysbuild/mcuboot/boards/rak11160.conf
```kconfig
# Due to low flash area of RAK3172, closing logging
CONFIG_LOG=n
CONFIG_LOG_PRINTK=n

CONFIG_BOOT_BANNER=n
CONFIG_DEBUG_OPTIMIZATIONS=n
CONFIG_SERIAL=n
CONFIG_UART_INTERRUPT_DRIVEN=n
CONFIG_CONSOLE=n
CONFIG_UART_CONSOLE=n
CONFIG_RTT_CONSOLE=n
CONFIG_USB_DEVICE_STACK=n
CONFIG_STDOUT_CONSOLE=n
```

## app/hello_world/sample.yaml
```yaml
sample:
  name: Hello World
tests:
  sample.hello_world:
    platform_allow:
      - rak3112/esp32s3/procpu
      - rak3172
      - rak4631
      - rak5010
      - rak11720
    tags: rak
    build_only: true
```

## app/lora/lora_test/sample.yaml
```yaml
sample:
  name: Power Test
tests:
  sample.lora.lora_test:
    platform_allow:
      - rak3112/esp32s3/procpu
      - rak3172
      - rak4631
      - rak11160
      - rak11720
    tags: rak
    build_only: true
```

## app/lora/lorawan_otaa/boards/rak3172.conf
```kconfig
# The build won't fit on the partition allocated for it without size
# optimizations.
CONFIG_SIZE_OPTIMIZATIONS=y

# Unnecesary flags for RAK3172
CONFIG_MCUMGR_TRANSPORT_BT_REASSEMBLY=n
CONFIG_MCUMGR_TRANSPORT_BT=n
CONFIG_MCUMGR_TRANSPORT_BT_CONN_PARAM_CONTROL=n
```

## app/sensor/rak1901/sample.yaml
```yaml
sample:
  name: RAK1901
tests:
  sample.sensor.rak1901:
    platform_allow:
      - rak3112/esp32s3/procpu
      - rak3172
      - rak4631
      - rak5010
      - rak11720
    tags: rak
    build_only: true
```

## app/sensor/rak1904/sample.yaml
```yaml
sample:
  name: RAK1904
tests:
  sample.sensor.rak1904:
    platform_allow:
      - rak3112/esp32s3/procpu
      - rak3172
      - rak4631
      - rak5010
      - rak11720
    tags: rak
    build_only: true
```

## boards/rakwireless/rak11160/Kconfig.rak11160
```kconfig
# Copyright (c) 2024 Kenneth Lu <kuohsianglu@gmail.com>
# SPDX-License-Identifier: Apache-2.0

config BOARD_RAK11160
	select SOC_STM32WLE5XX
```

## boards/rakwireless/rak3112/Kconfig
```kconfig
# Copyright (c) 2025 RAKwireless Technology Co., Ltd. <www.rakwireless.com>
# Sercan Erat <sercanerat@gmail.com>
# SPDX-License-Identifier: Apache-2.0

config HEAP_MEM_POOL_ADD_SIZE_BOARD
	int
	default 4096 if BOARD_RAK3112_ESP32S3_PROCPU
	default 256 if BOARD_RAK3112_ESP32S3_APPCPU
```

## boards/rakwireless/rak3112/Kconfig.rak3112
```kconfig
# Copyright (c) 2025 RAKwireless Technology Co., Ltd. <www.rakwireless.com>
# Sercan Erat <sercanerat@gmail.com>
# SPDX-License-Identifier: Apache-2.0

config BOARD_RAK3112
	select SOC_ESP32S3_WROOM_N16R8
	select SOC_ESP32S3_PROCPU if BOARD_RAK3112_ESP32S3_PROCPU
	select SOC_ESP32S3_APPCPU if BOARD_RAK3112_ESP32S3_APPCPU
```

## boards/rakwireless/rak3112/Kconfig.sysbuild
```kconfig
# Copyright (c) 2025 RAKwireless Technology Co., Ltd. <www.rakwireless.com>
# Sercan Erat <sercanerat@gmail.com>
# SPDX-License-Identifier: Apache-2.0

choice BOOTLOADER
	default BOOTLOADER_MCUBOOT
endchoice

choice BOOT_SIGNATURE_TYPE
	default BOOT_SIGNATURE_TYPE_NONE
endchoice
```

## boards/rakwireless/rak3112/board.yml
```yaml
board:
  name: rak3112
  full_name: RAK3112
  vendor: espressif
  socs:
  - name: esp32s3
```

## boards/rakwireless/rak3112/rak3112_appcpu_defconfig
```kconfig
# Copyright (c) 2025 RAKwireless Technology Co., Ltd. <www.rakwireless.com>
# Sercan Erat <sercanerat@gmail.com>
# SPDX-License-Identifier: Apache-2.0

CONFIG_CLOCK_CONTROL=y
```

## boards/rakwireless/rak3112/rak3112_procpu_defconfig
```kconfig
# Copyright (c) 2025 RAKwireless Technology Co., Ltd. <www.rakwireless.com>
# Sercan Erat <sercanerat@gmail.com>
# SPDX-License-Identifier: Apache-2.0

CONFIG_CONSOLE=y
CONFIG_SERIAL=y
CONFIG_UART_CONSOLE=y
CONFIG_GPIO=y
CONFIG_CLOCK_CONTROL=y
```

## modules/Kconfig
```kconfig
# SPDX-License-Identifier: Apache-2.0

menu "RAK Modules"

rsource "board/Kconfig"

endmenu
```

## modules/board/Kconfig
```kconfig
# SPDX-License-Identifier: Apache-2.0

config RAK_BOARD_4631_EARLY_INIT
	bool "Set RAK4631 board UICR value to 3.3V"
	default y
	depends on BOARD_RAK4631
	help
	  This option set RAK4631 board UICR value to 3.3V.
```

## modules/calculator/Kconfig
```kconfig
# SPDX-License-Identifier: Apache-2.0

config CALCULATOR_MODULE
	bool "Calculator Module Support"
	help
	  This option enables Calculator module
```
