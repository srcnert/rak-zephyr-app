## prj.conf
```kconfig
CONFIG_GPIO=y

CONFIG_LOG=y
CONFIG_LOG_PRINTK=n
CONFIG_USE_SEGGER_RTT=y
CONFIG_LOG_BACKEND_RTT=y
CONFIG_LOG_BACKEND_UART=n
```

## boards/rak3172.overlay
```dts
/ {
	chosen {
		zephyr,console = &lpuart1;
		zephyr,shell-uart = &lpuart1;
	};

	aliases {
		blue-led = &blue_led;
		green-led = &green_led;
	};
};

&lpuart1 {
	pinctrl-0 = <&lpuart1_tx_pa2 &lpuart1_rx_pa3>;
	pinctrl-names = "default";
	current-speed = <115200>;
	status = "okay";
};
```

## src/main.c
```c
#include <zephyr/kernel.h>
#include <zephyr/drivers/gpio.h>

#include <zephyr/logging/log.h>
LOG_MODULE_REGISTER(main, LOG_LEVEL_DBG);

/* 1000 msec = 1 sec */
#define SLEEP_TIME_MS 1000

/*
 * A build error on this line means your board is unsupported.
 * See the sample documentation for information on how to fix this.
 */
static const struct gpio_dt_spec led = GPIO_DT_SPEC_GET(DT_ALIAS(green_led), gpios);

#if defined(CONFIG_BOARD_RAK4631)
static void configure_uicr(void) {
	if ((NRF_UICR->REGOUT0 & UICR_REGOUT0_VOUT_Msk) !=
		(UICR_REGOUT0_VOUT_3V3 << UICR_REGOUT0_VOUT_Pos)) {
		NRF_NVMC->CONFIG = NVMC_CONFIG_WEN_Wen;
		while (NRF_NVMC->READY == NVMC_READY_READY_Busy){}

		NRF_UICR->REGOUT0 = (NRF_UICR->REGOUT0 & ~((uint32_t)UICR_REGOUT0_VOUT_Msk)) |
							(UICR_REGOUT0_VOUT_3V3 << UICR_REGOUT0_VOUT_Pos);

		NRF_NVMC->CONFIG = NVMC_CONFIG_WEN_Ren;
		while (NRF_NVMC->READY == NVMC_READY_READY_Busy){}

		LOG_INF("REGOUT0 is updated!");

		// System reset is needed to update UICR registers.
		NVIC_SystemReset();
	}
}
#endif

int main(void)
{
	int ret = -1;
	bool led_state = false;

#if defined(CONFIG_BOARD_RAK4631)
	configure_uicr();
#endif

	if (!gpio_is_ready_dt(&led)) {
		LOG_ERR("LED is not ready!");
	}

	ret = gpio_pin_configure_dt(&led, GPIO_OUTPUT_ACTIVE);
	if (ret) {
		LOG_ERR("Failed to configure LED!");
	}

	ret = gpio_pin_set_dt(&led, 1); // ON
	if (ret) {
		LOG_ERR("Failed to control LED!");
	}
	k_msleep(1000);
	ret = gpio_pin_set_dt(&led, 0); // OFF
	if (ret) {
		LOG_ERR("Failed to control LED!");
	}

	LOG_INF("Blinky! %s", CONFIG_BOARD);

	while (1) {
		gpio_pin_toggle_dt(&led);
		led_state = !led_state;
		printf("LED state: %s\n", led_state ? "ON" : "OFF");

		k_msleep(SLEEP_TIME_MS);
	}

	return 0;
}
```

## src/rtt.c
```c
#include <zephyr/kernel.h>

/* Do not use this file at your production code!!! */

#if (CONFIG_LOG && CONFIG_USE_SEGGER_RTT)
#include <SEGGER_RTT.h>
#define LOG_FLUSH() while (((CoreDebug->DHCSR & CoreDebug_DHCSR_C_DEBUGEN_Msk) == 1) && (SEGGER_RTT_HasDataUp(0) > 0)) {}
#else
#define LOG_FLUSH() (void) 0
#endif

#define RTT_THREAD_STACKSIZE 256
#define RTT_THREAD_PRIORITY 10

void rtt_thread_handler(void) {
	while (1) {
		LOG_FLUSH(); // Wait for RTT buffer to clear
		k_msleep(1000);
	}
}
K_THREAD_DEFINE(rtt_thread_id, RTT_THREAD_STACKSIZE, rtt_thread_handler, NULL, NULL, NULL,
		RTT_THREAD_PRIORITY, 0, 0);
```
