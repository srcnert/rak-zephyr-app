## west.yml
```yaml
# SPDX-License-Identifier: Apache-2.0

manifest:
  self:
    path: wisblock-for-zephyr
    west-commands: scripts/west-commands.yml

  remotes:
    - name: zephyrproject-rtos
      url-base: https://github.com/zephyrproject-rtos
    - name: rak-fork
      url-base: https://github.com/srcnert

  projects:
    - name: zephyr
      remote: rak-fork
      revision: main
      import:
        # By using name-allowlist we can clone only the modules that are
        # strictly needed by the wisblock-for-zephyr applications.
        name-allowlist:
          - cmsis
          - cmsis_6
          - segger
          - loramac-node
          - hal_espressif
          - hal_nordic
          - hal_ambiq
          - hal_st
          - hal_stm32
          - tinycrypt
          - mcuboot
          - mbedtls
          - zcbor
          - littlefs
          - tf-psa-crypto
```
